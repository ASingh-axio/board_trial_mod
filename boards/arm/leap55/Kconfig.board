## boards/arm/leap55/Kconfig.board
```kconfig
# nRF52840-MDK board configuration

#config BOARD_LEAP55_LEFT
#    def_bool $(shields_list_contains,oixa5_left)
    

#config BOARD_LEAP55_RIGHT
#    def_bool $(shields_list_contains,oixa5_right)


config BOARD_LEAP55_LEFT
    bool "leap55 left"
    depends on SOC_NRF52840_QIAA

config BOARD_LEAP55_RIGHT
    bool "leap55 right"
    depends on SOC_NRF52840_QIAA
```

## boards/arm/leap55/Kconfig.defconfig
```kconfig
# Copyright (c) 2018 makerdiary.com
# SPDX-License-Identifier: Apache-2.0

if BOARD_LEAP55_LEFT

config ZMK_KEYBOARD_NAME
    default "Leap55!"

config ZMK_SPLIT_ROLE_CENTRAL
    default y

endif # BOARD_LEAP55_LEFT


if BOARD_LEAP55_LEFT || BOARD_LEAP55_RIGHT

config BOARD
    default "leep55!!!!"

config ZMK_SPLIT
    default y

if USB_DEVICE_STACK

config USB_NRFX
    default y

endif # USB_DEVICE_STACK

config BT_CTLR
	default BT

if ZMK_BACKLIGHT

config PWM
    default y

config LED_PWM
    default y

endif # ZMK_BACKLIGHT

endif # BOARD_LEAP55_LEFT || BOARD_LEAP55_RIGHT
```

## boards/arm/leap55/leap55_defconfig
```kconfig
# SPDX-License-Identifier: Apache-2.0

CONFIG_SOC_SERIES_NRF52X=y
CONFIG_SOC_NRF52840_QIAA=y
#CONFIG_CLOCK_CONTROL_NRF_K32SRC_RC=y
CONFIG_BOARD_LEAP5=y


# Enable MPU
CONFIG_ARM_MPU=y
CONFIG_PINCTRL=y

# enable GPIO
CONFIG_GPIO=y

CONFIG_USE_DT_CODE_PARTITION=y
CONFIG_BUILD_OUTPUT_UF2=y

CONFIG_MPU_ALLOW_FLASH_WRITE=y
CONFIG_NVS=y
CONFIG_SETTINGS_NVS=y
CONFIG_FLASH=y
CONFIG_FLASH_PAGE_LAYOUT=y
CONFIG_FLASH_MAP=y

CONFIG_ZMK_USB=y
CONFIG_ZMK_BLE=y
CONFIG_ZMK_USB_LOGGING=y
CONFIG_LOG_PROCESS_THREAD_STARTUP_DELAY_MS=8000

CONFIG_ZMK_BATTERY_REPORT_INTERVAL=240
CONFIG_BT_CTLR_TX_PWR_PLUS_8=y

# LED indicators
CONFIG_ZMK_HID_INDICATORS=y
CONFIG_LED=y

CONFIG_ZMK_BACKLIGHT=y
CONFIG_ZMK_BACKLIGHT_BRT_STEP=20
CONFIG_ZMK_BACKLIGHT_BRT_START=60
CONFIG_ZMK_BACKLIGHT_ON_START=n
CONFIG_ZMK_BACKLIGHT_AUTO_OFF_IDLE=n
```

## boards/arm/leap55/leap55_right_defconfig
```kconfig
CONFIG_SOC_SERIES_NRF52X=y
CONFIG_SOC_NRF52840_QIAA=y
CONFIG_BOARD_LEAP55_RIGHT=y
CONFIG_BUILD_OUTPUT_UF2=y
```
